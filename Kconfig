## Kconfig
```kconfig
DT_COMPAT_ZMK_BEHAVIOR_NUM_SESSION := zmk,behavior-num-session

config ZMK_BEHAVIOR_NUM_SESSION
	bool
	default y
	depends on DT_HAS_ZMK_BEHAVIOR_NUM_SESSION_ENABLED

if ZMK_BEHAVIOR_NUM_SESSION

config ZMK_BEHAVIOR_NUM_SESSION_MAX_ACTIVE
	int "Maximum simultaneous num-session layers"
	default 10
	range 1 32

endif
```

## dts/bindings/behaviors/zmk,behavior-num-session.yaml
```yaml
description: Smart number-session behavior

compatible: "zmk,behavior-num-session"

include: one_param.yaml

properties:
  "#binding-cells":
    type: int
    required: true
    const: 1
  continue-list:
    type: array
    required: false
    description: |
      Extra key codes that keep the session active before the first modifier.
      Applied in addition to ignore-numbers / ignore-alphas.
  ignore-alphas:
    type: boolean
    description: Keep the session active for alphabetic keys (before the first modifier).
  ignore-numbers:
    type: boolean
    description: Keep the session active for numeric keys (before the first modifier).
```
